/*
 * Copyright (C) 2015 CompuLab LTD.
 *
 * This program is free software; you can redistribute it and/or modify
 * it under the terms of the GNU General Public License version 2 as
 * published by the Free Software Foundation.
 */

/dts-v1/;

#include "imx6ul-cl-som-imx6ul.dtsi"

/ {
	model = "CompuLab i.MX6 UltraLite SoM";
	compatible = "fsl,imx6ul", "compulab,cl-som-imx6ul";
};
