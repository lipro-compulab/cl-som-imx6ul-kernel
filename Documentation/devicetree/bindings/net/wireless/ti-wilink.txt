## Documentation/devicetree/bindings/net/wireless/ti-wilink.txt
```
TI WiLink Wireless Modules Device Tree Bindings
===============================================

The WiLink modules provide wireless connectivity, such as WLAN,
Bluetooth, FM and NFC.

There are several different modules available, which can be grouped by
their generation: WiLink6, WiLink7 and WiLink8.  WiLink4 is not
currently supported with device tree.

Currently, only the WLAN portion of the modules is supported with
device tree.

Required properties:
--------------------

- compatible: should be "ti,wilink6", "ti,wilink7" or "ti,wilink8"
- interrupt-parent: the interrupt controller
- interrupts: out-of-band WLAN interrupt
	See the interrupt controller's bindings documentation for
	detailed definition.

Optional properties:
--------------------

- clocks: list of clocks needed by the chip as follows:

  refclock: the internal WLAN reference clock frequency (required for
	WiLink6 and WiLink7; not used for WiLink8).

  tcxoclock: the internal WLAN TCXO clock frequency (required for
	WiLink7 not used for WiLink6 and WiLink8).

  The clocks must be defined and named accordingly.  For example:

  clocks = <&refclock>
  clock-names = "refclock";

  refclock: refclock {
		     compatible = "ti,wilink-clock";
		     #clock-cells = <0>;
		     clock-frequency = <38400000>;
	};

  Some modules that contain the WiLink chip provide clocks in the
  module itself.  In this case, we define a "ti,wilink-clock" as shown
  above.  But any other clock could in theory be used, so the proper
  clock definition should be used.


Example:
--------

Example definition that can be used in OMAP4 Panda:

wlan {
	compatible = "ti,wilink6";
	interrupt-parent = <&gpio2>;
	interrupts = <21 0x4>;	/* gpio line 53, high level triggered */
	clocks = <&refclock>;
	clock-names = "refclock";

	refclock: refclock {
		compatible = "ti,wilink-clock";
		#clock-cells = <0>;
		clock-frequency = <38400000>;
	};
};
```

## Documentation/devicetree/bindings/soc/ti/keystone-crypto.txt
```
Keystone Crypto Driver

This document explains the device tree bindings for the side-band Security
Accelerator on keystone devices. 

Required properties:
 - compatible: should be "ti,keystone-crypto".

 - clock: pandle to clksa clock.

 - reg: Should contain register location and length of the SA hardware
	module.

 - ti,navigator-dmas and ti,navigator-dma-names: Security accelerator uses
	2 dma channels. Rx and Tx. The first property is the pandle to the
	knav_dmas subsystem and flow for RX channel and channel number for
	TX channel. The second property is corresponding channel names.

 - rx-channel: name of RX channel.

 - rx-queue-depth and rx-buffer-size: RX channel may use upto 4 free
 	descriptor queue. Those properties describes number of buffers in
	each queue and the buffer's length.

 - rx-compl-queue: RX completion queue number.
 
 - rx-pool: number of buffer descriptos and region for rx-pool.

 - tx-channel: name of TX channel.

 - tx-queue-depth: number of TX descriptos.

 - tx-compl-queue: TX completion queue number.

 - tx-pool: number of buffer descriptos and region for tx-pool.

 - tx-submit-queue: submition queue number for TX channel.

 - sc-id: ???


Example:

crypto@20c0000 {
	compatible = "ti,keystone-crypto";
	label = "crypto-gbe";
	reg = <0x20c0000 0x40000>;
	clocks = <&clksa>;

	ti,navigator-dmas = <&dma_gbe 26>, <&dma_gbe 6>;
	ti,navigator-dma-names = "crypto-rx", "crypto-tx";

	rx-channel = "crypto-rx";
	rx-queue-depth = <256 64 0 0>;
	rx-buffer-size = <1500 4096 0 0>;
	rx-compl-queue = <8712>;
	rx-pool	= <512 12>;

	tx-channel = "crypto-tx";
	tx-queue-depth = <256>;
	tx-compl-queue = <8713>;
	tx-pool = <512 12>;
	tx-submit-queue = <646>;

	sc-id = <0x7000 0x71ff>;
};
```
